## drivers/misc/carillon/Kconfig
```kconfig
comment "Sony Carillon NFC driver"

config NFC_CARILLON
	tristate "Sony Carillon protocol driver (I2C) devices"
	default n
```

## drivers/staging/kscl/Kconfig
```kconfig
config SONY_FIPS_KSCL
	tristate "Sony FIPS AES-XTS/AES-CBC driver"
	depends on ARCH_SONY_YOSHINO
	default n
	---help---
	This driver support Netlogic XLR/XLS on chip gigabit
	Ethernet.
```
